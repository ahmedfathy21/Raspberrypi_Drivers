/dts-v1/;
/plugin/;

/ {
    compatible = "brcm,bcm2711";

    fragment@0 {
        target = <&leds>;
        __overlay__ {
            custom_led: custom_led {
                label = "custom_led";
                gpios = <&gpio 17 0>; // GPIO pin 17, active high
                linux,default-trigger = "none";
            };
        };
    };
};

